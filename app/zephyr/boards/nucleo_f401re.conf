## app/zephyr/boards/nucleo_f401re.conf
```kconfig
# 96 KB RAM.
CONFIG_MAIN_STACK_SIZE=12288
CONFIG_COMMON_LIBC_MALLOC_ARENA_SIZE=20480
```

## app/zephyr/boards/nucleo_f446re.conf
```kconfig
# 128 KB RAM.
CONFIG_MAIN_STACK_SIZE=16384
CONFIG_COMMON_LIBC_MALLOC_ARENA_SIZE=45056
```
